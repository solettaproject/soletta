## src/samples/flow/basics/Kconfig
```kconfig
config FLOW_BASICS_CMDLINE_ARGS_SAMPLE
	bool
	depends on FLOW_FBP_GENERATOR_SAMPLES && FLOW_NODE_TYPE_APP && FLOW_NODE_TYPE_CONSOLE && FLOW_NODE_TYPE_INT && FLOW_NODE_TYPE_CONSTANT && FLOW_NODE_TYPE_CONVERTER
	default y

config FLOW_BASICS_FIBONACCI_SAMPLE
	bool
	depends on FLOW_FBP_GENERATOR_SAMPLES && FLOW_NODE_TYPE_CONSTANT && FLOW_NODE_TYPE_INT && FLOW_NODE_TYPE_SWITCHER && BOOLEAN && FLOW_NODE_TYPE_CONSOLE && FLOW_NODE_TYPE_APP && FLOW_NODE_TYPE_CONVERTER
	default y

config FLOW_BASICS_PLATORM_SERVICE_SAMPLE
	bool
	depends on FLOW_FBP_GENERATOR_SAMPLES && FLOW_NODE_TYPE_TIMER && FLOW_NODE_TYPE_CONSOLE && FLOW_NODE_TYPE_PLATFORM
	default y

config FLOW_BASICS_SIMPLE_SAMPLE
	bool
	depends on FLOW_FBP_GENERATOR_SAMPLES && FLOW_NODE_TYPE_TIMER && FLOW_NODE_TYPE_BOOLEAN && FLOW_NODE_TYPE_CONSOLE
	default y

config FLOW_BASICS_SUBPROCESS_BC_SAMPLE
	bool
	depends on FLOW_FBP_GENERATOR_SAMPLES && FLOW_NODE_TYPE_PROCESS && FLOW_NODE_TYPE_CONSOLE && FLOW_NODE_TYPE_CONSTANT
	default y

config FLOW_BASICS_KEYBOARD_SAMPLE
	bool
	depends on FLOW_FBP_GENERATOR_SAMPLES && FLOW_NODE_TYPE_KEYBOARD && FLOW_NODE_TYPE_CONSOLE
	default y

config FLOW_BASICS_SET_TARGET_SAMPLE
       bool
       depends on FLOW_FBP_GENERATOR_SAMPLES && FLOW_NODE_TYPE_PLATFORM && FLOW_NODE_TYPE_CONSTANT && FLOW_NODE_TYPE_TIMER && FLOW_NODE_TYPE_CONVERTER && FLOW_NODE_TYPE_GPIO
       default y

config FLOW_BASICS_WEEKDAY_SAMPLE
	bool
	depends on FLOW_FBP_GENERATOR_SAMPLES && FLOW_NODE_TYPE_WALLCLOCK && FLOW_NODE_TYPE_SWITCHER && FLOW_NODE_TYPE_CONSOLE && FLOW_NODE_TYPE_CONSTANT
	default y

config FLOW_BASICS_TIMEBLOCK_SAMPLE
	bool
	depends on FLOW_FBP_GENERATOR_SAMPLES && FLOW_NODE_TYPE_WALLCLOCK && FLOW_NODE_TYPE_CONSOLE
	default y
```
