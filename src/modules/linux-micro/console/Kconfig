## src/modules/linux-micro/console/Kconfig
```kconfig
config LINUX_MICRO_CONSOLE
	tristate "console"
	depends on LINUX_MICRO
	default m if MODULES=y
	help
            Spawns agetty (or getty or /bin/sh) on consoles defined by
            kernel, respawning as they exit.

            This service is useful during development or devices that
            should allow maintenance access using a serial console.

            The consoles are defined by the kernel as it reads the
            kernel command line for "console=XXX" statements, see
            https://www.kernel.org/doc/Documentation/serial-console.txt

            If agetty or getty binaries exist, they will be
            executed. Otherwise /bin/sh is spawned and no login will
            be prompted (be careful to only use this during
            development).
```

## src/modules/linux-micro/dbus/Kconfig
```kconfig
config LINUX_MICRO_DBUS
	tristate "dbus"
	depends on LINUX_MICRO
	default m if MODULES=y
	help
            Start and monitor dbus-daemon. D-Bus is a message bus
            system, a simple way for applications to talk to one
            another. In addition to interprocess communication, D-Bus
            helps coordinate process lifecycle; it makes it simple and
            reliable to code a "single instance" application or
            daemon, and to launch applications and daemons on demand
            when their services are needed.

            There is an ongoing effort to merge D-Bus in the Linux
            Kernel (so called 'kdbus'), in this case the dbus-daemon
            will be required only to coordinate process lifecycle
            (such as spawning processes that implement a given
            service).

            http://www.freedesktop.org/wiki/Software/dbus/
```

## src/modules/linux-micro/fstab/Kconfig
```kconfig
config LINUX_MICRO_FSTAB
	tristate "fstab"
	depends on LINUX_MICRO
	default m if MODULES=y
	help
            Mounts filesystems in /etc/fstab.

            This is a simple implementation that will mount entries,
            however no filesystem check (fsck) is done, the fifth and
            sixth fields (fs_freq and fs_passno) are not used.

            The file /etc/fstab is optional, if it doesn't exist the
            service starts but nothing is mounted.
```

## src/modules/linux-micro/hostname/Kconfig
```kconfig
config LINUX_MICRO_HOSTNAME
	tristate "hostname"
	depends on LINUX_MICRO
	default m if MODULES=y
	help
            Reads /etc/hostname and sets machine hostname.

            The file is read, leading and trailing spaces are ignored
            and then the resulting string is sent directly to
            sethostname(2).

            The file /etc/hostname must exist.
```

## src/modules/linux-micro/kmod/Kconfig
```kconfig
config LINUX_MICRO_KMOD
	tristate "kmod"
	depends on LINUX_MICRO && HAVE_LIBKMOD
	default m if MODULES=y
	help
            Implements the modprobe process following the systemd's modules-load.d
            specification, also does the coldplug module loading - which consists in
            looking up devices described in the sysfs and loading their respective
            modules based on the modalias descriptors.

            This module will also handle the hotplug events, notified by the kernel
            via uevent netlink channel.
```

## src/modules/linux-micro/locale/Kconfig
```kconfig
config LINUX_MICRO_LOCALE
	tristate "locale"
	depends on LINUX_MICRO
	default m if MODULES=y
	help
            Sets locale environment variables.

            This service will mimic systemd-localed.service and read
            the locale setting from /etc/locale.conf or kernel command
            line, then setting the environment variables in the
            current and children processes.

            The format of /etc/locale.conf is key=value, with key
            being one of: LANG, LANGUAGE, LC_CTYPE, LC_NUMERIC,
            LC_TIME, LC_COLLATE, LC_MONETARY, LC_MESSAGES, LC_PAPER,
            LC_NAME, LC_ADDRESS, LC_TELEPHONE, LC_MEASUREMENT,
            LC_IDENTIFICATION. For details about semantic refer to
            man:locale(7).

            The same variables may be set from kernel command line by
            using a prefix "locale.", then to set LANG to en_US.UTF-8
            use: "locale.LANG=en_US.UTF-8".

            In order to use locales your libc must be compiled with
            such support and locales to be used must be included in
            the device disk image (ie: for glibc /usr/lib/locale).

            See http://www.freedesktop.org/software/systemd/man/locale.conf.html
```

## src/modules/linux-micro/machine-id/Kconfig
```kconfig
config LINUX_MICRO_MACHINE_ID
	tristate "machine-id"
	depends on LINUX_MICRO
	default m if MODULES=y
	help
            After fstab service is up, this one will start and
            guarantee the presence and validity of a unique machine
            identifier in the file system. This UUID is made available
            for the rest of Soletta by an utility function.
```

## src/modules/linux-micro/network-up/Kconfig
```kconfig
config LINUX_MICRO_NETWORK_UP
	tristate "network-up"
	depends on LINUX_MICRO && NETWORK
	default m if MODULES=y
	help
            This service will enumerate all network interfaces using
            netlink and then bring up all of them.

            If the kernel is configured for IPv6 (CONFIG_IPV6=y) then
            an automatic address is assigned based on the MAC address.

            This service relies on netlink communication with the
            kernel.
```

## src/modules/linux-micro/rc-d/Kconfig
```kconfig
config LINUX_MICRO_RC_D
	tristate "rc-d"
	depends on LINUX_MICRO && MODULES=y && m
	default m if MODULES=y
	help
            This is a meta-service that offers rc.d (init.d) like
            functionality to Soletta's linux-micro platform.

            This service is not to be used directly, instead one must
            compile it as a dynamically loadable module and create
            links to it in order to offer new services that will be
            managed by executing /etc/init.d or /etc/rc.d binaries
            with known arguments.

            Example: to expose /etc/init.d/atd service to Soletta
            (sol_platform_start_service("atd")), then:

            $ cd $PREFIX/lib/soletta/modules/linux-micro
            $ ln -s rc-d.so atd.so # enables the service 'atd' using rc.d

            The /etc/init.d/atd will be then called with the following
            arguments: start, stop, restart and status. The "status"
            is called periodically (every 5s) if there is a service
            monitor (sol_platform_add_service_monitor()).

            Ideally these services are only used during development,
            for final products we recommend creating a native service
            implemented in C.
```

## src/modules/linux-micro/sysctl/Kconfig
```kconfig
config LINUX_MICRO_SYSCTL
	tristate "sysctl"
	depends on LINUX_MICRO
	default m if MODULES=y
	help
            Sets kernel parameters from sysctl.conf files.

            This service will mimic systemd-sysctl.service and read
            the settings from /etc/sysctl.conf or /run/sysctl.d,
            /etc/sysctl.d, /usr/local/lib/sysctl.d, /usr/lib/sysctl.d,
            /lib/sysctl.d. Files are processed in alphabetical order.

            See http://www.freedesktop.org/software/systemd/man/systemd-sysctl.service.html
```

## src/modules/linux-micro/watchdog/Kconfig
```kconfig
config LINUX_MICRO_WATCHDOG
	tristate "watchdog"
	depends on LINUX_MICRO
	default m if MODULES=y
	help
            Start and keep alive the kernel watchdog.

            Linux provides a watchdog API with both software and
            hardware implementations. The software implementation may
            be used to protect against userspace hangups, while the
            hardware may protect from kernel hangups as well.

            This module will open /dev/watchdog, check the period and
            start a timer to keep the watchdog alive, avoiding the
            system to be rebooted. If the application hangs for more
            than such period, the watchdog will reboot the device.

            See https://www.kernel.org/doc/Documentation/watchdog/watchdog-api.txt
```

## src/modules/pin-mux/contiki-qmsi/Kconfig
```kconfig
config PIN_MUX_CONTIKI_QMSI_QUARK_SE
    bool
    default y if BOARD_NAME = "quark-se-devboard"

config PIN_MUX_CONTIKI_QMSI_QUARK_D2000
    bool
    default y if BOARD_NAME = "quark-d2000-devboard"
```

## src/modules/pin-mux/intel-edison-rev-c/Kconfig
```kconfig
config PIN_MUX_INTEL_EDISON_REV_C
        tristate "Intel Edison (Rev C)"
        depends on USE_PIN_MUX
        default m
```

## src/modules/pin-mux/intel-galileo-rev-d/Kconfig
```kconfig
config PIN_MUX_INTEL_GALILEO_REV_D
        tristate "Intel Galileo (Rev D)"
        depends on HAVE_PIN_MUX
        default m
```

## src/modules/pin-mux/intel-galileo-rev-g/Kconfig
```kconfig
config PIN_MUX_INTEL_GALILEO_REV_G
        tristate "Intel Galileo Gen 2 (Rev G)"
        depends on HAVE_PIN_MUX
        default n
```

## src/modules/update/Kconfig
```kconfig
menuconfig USE_UPDATE
    bool "Update Options"
    default y
    help
        Allow Soletta built apps to be updated automatically.

        Soletta can check if there is an update available and update itself.
        Different update modules are provided for different Soletta
        app scenarios.

source "src/modules/update/linux-micro-efi/Kconfig"
```

## src/modules/update/linux-micro-efi/Kconfig
```kconfig
config LINUX_MICRO_EFI_UPDATE
    tristate "Soletta Linux Micro EFI Update"
    depends on USE_UPDATE && PLATFORM_LINUX_MICRO && HTTP_CLIENT && CRYPTO_MESSAGE_DIGEST
    default m if MODULES=y
    help
        Allows Soletta auto update when it is running as static PID 1 (Linux
        Micro) on EFI systems. To completely use this module to update Soletta,
        it's necessary that device boots via EFI script startup.nsh.
        This script should also check the existence of an 'updating' file
        on boot partition (usually 'fs0:'), that update module will write there
        to indicate that an update happened. It's up to this script to decide
        if update was successful or not. If not, it shall start old Soletta app,
        usually '/usr/bin/soletta_old'.
        An example of such script is provided on samples/flow/update/startup.nsh.


config LINUX_MICRO_EFI_UPDATE_META_URL
    string "Linux Micro EFI Update Metadata URL"
    depends on LINUX_MICRO_EFI_UPDATE
    default "http://localhost/update-meta"
    help
        URL to get update information. It must return a JSON containing the
        fields "version", "hash", "hash-algorithm" and "size", like:
        {
            "version": "0.1.2",
            "hash": "402c09cded5f597c94f90d1b77c04422628678f69f6f56786053c8c59450c1da"
            "hash-algorithm": sha256,
            "size": 369874
        }

config LINUX_MICRO_EFI_UPDATE_FETCH_URL
    string "Linux Micro EFI Update Fetch URL"
    depends on LINUX_MICRO_EFI_UPDATE
    default "http://localhost:8000/file"
    help
        URL to fetch update file. Version name will be appended to it, so
        the real query would look like "http://localhost:8000/file/0.1.2".

config LINUX_MICRO_EFI_UPDATE_APP_PATH
    string "Path where application is located"
    depends on LINUX_MICRO_EFI_UPDATE
    default "/usr/bin/soletta"
    help
        Path where application is located. Update module will install new
        version by overwriting this location with new file - but before, it
        will create an "LINUX_MICRO_EFI_UPDATE_APP_PATH-old" backup file.
        Note that 'startup.nsh' needs to agree where application file is
        located.
```

## src/samples/bluetooth/Kconfig
```kconfig
config BLUETOOTH_SAMPLES
	bool "Bluetooth samples"
	depends on BLUETOOTH && SAMPLES
	default y
```

## src/samples/coap/Kconfig
```kconfig
config COAP_SAMPLES
	bool "CoAP samples"
	depends on COAP && SAMPLES
	default y

config COAP_CLIENT_SERVER_SAMPLES
	bool "CoAP client/server samples"
	depends on COAP_SAMPLES
	default y

config OIC_SAMPLES
	bool "OIC samples"
	depends on OIC && COAP_SAMPLES
	default y

config LWM2M_SAMPLES
       bool "LWM2M samples"
       depends on LWM2M && COAP_SAMPLES
       default y
```

## src/samples/common/Kconfig
```kconfig
config COMMON_SAMPLES
	bool "Common samples"
	default y

config LINUX_MICRO_INIT_SAMPLE
	bool "Linux Micro Init"
	depends on PLATFORM_LINUX_MICRO && COMMON_SAMPLES
	default y

config PLATFORM_SIMPLE_SAMPLE
	bool "Platform Simple"
	depends on COMMON_SAMPLES
	default y

config UART_SAMPLE
	bool "UART"
	depends on COMMON_SAMPLES
	default y
```

## src/samples/crypto/Kconfig
```kconfig
config CRYPTO_SAMPLES
	depends on SAMPLES
	bool "Cryptography & Signatures Samples"
	default y

config MESSAGE_DIGEST_SAMPLE
	bool "Message Digest (Hash) samples"
	depends on CRYPTO_MESSAGE_DIGEST && CRYPTO_SAMPLES
	default y
```

## src/samples/design_patterns/Kconfig
```kconfig
config DESIGN_PATTERN_SAMPLES
	depends on SAMPLES
	bool "Design patterns samples"
	default y
```

## src/samples/flow/Kconfig
```kconfig
config FLOW_SAMPLES
	bool "Flow samples"
	depends on FLOW
	default y

config FLOW_BASICS_SAMPLES
	bool "Basics"
	depends on FLOW_SAMPLES && FBP_GENERATOR
	default y

config FLOW_BASICS_SIMPLE_SAMPLE
	bool "Simple fbp sample"
	depends on FLOW_BASICS_SAMPLES
	default y

config FLOW_BASICS_CMDLINE_ARGS_SAMPLE
	bool "Command line arguments sample"
	depends on FLOW_BASICS_SAMPLES
	default y

config FLOW_BASICS_FIBONACCI_SAMPLE
	bool "Fibonacci sample"
	depends on FLOW_BASICS_SAMPLES
	default y

config FLOW_BASICS_PLATORM_SERVICE_SAMPLE
	bool "Platform-service sample"
	depends on FLOW_BASICS_SAMPLE
	default y

config FLOW_COMPASS_SAMPLES
	bool "Compass"
	depends on FLOW_SAMPLES && FBP_GENERATOR
	default y

config FLOW_COMPASS_LSM303_SAMPLE
	bool "Compass lsm303 sample"
	depends on FLOW_COMPASS_SAMPLES && FLOW_NODE_TYPE_MAGNETOMETER && ACCELEROMETER
	default y

config FLOW_FOOSBALL_SAMPLE
	bool "Foosball sample"
	depends on FLOW_SAMPLES && FBP_GENERATOR
	default y

config FLOW_GTK_GALLERY_SAMPLE
	bool "Gtk-gallery sample"
	depends on FLOW_SAMPLES && FBP_GENERATOR && GTK
	default y

config FLOW_LD_STRIP_SAMPLES
	bool "Ld-strip"
	depends on FLOW_SAMPLES && FBP_GENERATOR
	default y

config FLOW_LD_STRIP_LPD8806_SAMPLE
	bool "lpd8806 sample"
	depends on FLOW_LD_STRIP_SAMPLES
	default y

config FLOW_MISC_SAMPLES
	bool "Misc samples"
	depends on FLOW_SAMPLES && FBP_GENERATOR
	default y

config FLOW_MISC_FILE_COPY_SAMPLE
	bool "File-copy sample"
	depends on FLOW_MISC_SAMPLES
	default y
```

## src/samples/flow/am2315/Kconfig
```kconfig
config FLOW_AM2315_SAMPLE
	bool
	depends on FLOW_FBP_GENERATOR_SAMPLES && FLOW_NODE_TYPE_AM2315 && FLOW_NODE_TYPE_TIMER && FLOW_NODE_TYPE_TEMPERATURE && FLOW_NODE_TYPE_CONSOLE
	default y
```
