## src/modules/flow/pwm/Kconfig
```kconfig
config FLOW_NODE_TYPE_PWM
	tristate "Node type: pwm"
	depends on USE_PWM
	default y
```

## src/modules/flow/regexp/Kconfig
```kconfig
config FLOW_NODE_TYPE_REGEXP
	tristate "Node type: regexp"
        depends on HAVE_LIBPCRE
	default y
	help
		The regexp (regular expressions) family of nodes
		provides regular expression facilities on your flow,
		acting on the strings contained in string packets:

		 - replace regular expression patterns in a string
		 - search for regular expression patterns in a string

		Only one regular expressions backend is supported, for
		now: libpcre.
```

## src/modules/flow/robotics/Kconfig
```kconfig
config FLOW_NODE_TYPE_ROBOTICS
    tristate "Node type: robotics"
    depends on USE_PWM
    default n
    help
        Series of node types related to robotics.

        Motor drivers, quadrature encoders, odometers, PID controls,
        steering controllers, etc.
```

## src/modules/flow/selector/Kconfig
```kconfig
config FLOW_NODE_TYPE_SELECTOR
	tristate "Node type: selector"
	default m
	help

		It is common to have IoT products with LCD display and
		buttons (arrows) and the need to ask for user input.
		This is a collection of high-level node types to deal
		with that, the *selector* nodes.

		These node types format a multi-line string to be
		used by other node types doing visual output, such as
		LCD display (grove/lcd-string), in conjuntion with others
		providing input.
```

## src/modules/flow/servo-motor/Kconfig
```kconfig
config FLOW_NODE_TYPE_SERVO_MOTOR
	tristate "Node type: servo-motor"
	depends on USE_PWM
	default m
```

## src/modules/flow/si114x/Kconfig
```kconfig
config FLOW_NODE_TYPE_SI114X
	tristate "Node type: si114x"
	depends on USE_I2C
	default n
```

## src/modules/flow/string/Kconfig
```kconfig
config FLOW_NODE_TYPE_STRING
	tristate "Node type: string"
	default y
	help
		The string family of nodes provide string facilities
		on your flow, acting on the strings contained in
		string packets:

		 - generate UUID strings
		 - split a string in others
		 - get a slice from a string
		 - check if a string is empty
		 - compare/concatenate two strings
		 - replace a substring in a string
		 - measure the length of the string
		 - change a string to lower/uppercase
		 - check whether a string stards/ends with another

		For most of string nodes, there may be two
		implementations (depending on the presence of the ICU
		library or not). We strongly recommend that you build
		Soletta with ICU, so that the full UTF-8 set of
		characters is properly handled by the string nodes.

# This is the sole user of ICU. If it gets wider use, move it up in the
# hierarchy.
config USE_ICU
	bool "Use ICU library"
	depends on HAVE_ICU && FLOW_NODE_TYPE_STRING
	default y
```

## src/modules/flow/stts751/Kconfig
```kconfig
config FLOW_NODE_TYPE_STTS751
	tristate "Node type: stts751"
	default n
	depends on USE_I2C
```

## src/modules/flow/thingspeak/Kconfig
```kconfig
config FLOW_NODE_TYPE_THINGSPEAK
	tristate "Node type: thingspeak"
	depends on FLOW && HTTP_CLIENT
	default y
	help
		ThingSpeak is a service that allows publishing data via HTTP
		to be consumed by IoT devices.

		It is an open platform, with full source code available.
		There is also a free service with API call rate limits.  If
		the rate limits are too low for your application, you can
		set up a server yourself; the node types allow specifying
		the API endpoint.

		This option enables three node types:

                  * thingspeak/talkback-execute, to query ThingSpeak's
                      Talkback queue
                  * thingspeak/talkback-add, to add something to the Talkback
                      queue
                  * thingspeak/channel-update, to update a channel

		To use these nodes, one must register and obtain an API key.
		API keys for channels and talkbacks are different.  For the
		talkback, obtaining a Talkback ID is also required.

		If unsure, say Y.
```

## src/modules/flow/trigonometry/Kconfig
```kconfig
config FLOW_NODE_TYPE_TRIGONOMETRY
	tristate "Node type: trigonometry"
	default y
```

## src/modules/flow/twitter/Kconfig
```kconfig
config FLOW_NODE_TYPE_TWITTER
	tristate "Node type: twitter"
	depends on HTTP_CLIENT
	default m
	help
		Provides a basic twitter client node. It allows one
		post tweets and get its own timeline.
```

## src/modules/flow/udev/Kconfig
```kconfig
config FLOW_NODE_TYPE_UDEV
	tristate "Node type: udev"
	depends on LINUX && HAVE_UDEV
	default m
```

## src/modules/flow/unix-socket/Kconfig
```kconfig
config FLOW_NODE_TYPE_UNIX_SOCKET
	tristate "Node type: unix-socket"
	depends on SOL_PLATFORM_LINUX
	default m
```

## src/modules/flow/update/Kconfig
```kconfig
config FLOW_NODE_TYPE_UPDATE
	tristate "Node type: update"
	depends on USE_UPDATE
	default m
    help
        Provides nodes to update a Soletta application. It allows checking
        for updates, fetch the file and install it. Operations
        will be performed by underlying update module, defined via
        SOL_UPDATE_MODULE environment variable.
```

## src/modules/linux-micro/Kconfig
```kconfig
menuconfig LINUX_MICRO
	bool "Linux Micro Platform Modules"
	depends on PLATFORM_LINUX_MICRO
	default y
	help

            Soletta can be compiled to use linux-micro as a target
            platform (Core Library > Target platform) and in this case
            the applications using it can be used as PID1 (the /init
            binary). In this case some extra care needs to be done,
            such as mounting /dev, /proc, /sys and handling children
            processes.

            The linux-micro platform will provide services
            (sol_platform_start_service()) to extend its functionality
            via modules. Modules can be built-in to the library or
            dynamically loadable modules (if Basics > MODULES=y), in
            this case they can be provided by third-parties. These
            modules will be looked at
            $PREFIX/lib/soletta/modules/linux-micro/<module>.so, where
            PREFIX is defined at Basics > Installation Prefix.

            Services can be automatically started if they are listed
            in /etc/soletta/initial-services or
            $PREFIX/lib/soletta/modules/linux-micro/initial-services. The
            format is one service (module) name per line. If a service
            fail to start, then the platform start will fail as a
            whole unless the line contains a suffix '?', making that
            service optional (may fail to start).

source "src/modules/linux-micro/bluetooth/Kconfig"
source "src/modules/linux-micro/console/Kconfig"
source "src/modules/linux-micro/dbus/Kconfig"
source "src/modules/linux-micro/fstab/Kconfig"
source "src/modules/linux-micro/hostname/Kconfig"
source "src/modules/linux-micro/locale/Kconfig"
source "src/modules/linux-micro/network-up/Kconfig"
source "src/modules/linux-micro/rc-d/Kconfig"
source "src/modules/linux-micro/sysctl/Kconfig"
source "src/modules/linux-micro/watchdog/Kconfig"
```

## src/modules/linux-micro/automount/Kconfig
```kconfig
config LINUX_MICRO_AUTOMOUNT
	tristate "automount"
	depends on LINUX_MICRO
	default m if MODULES=y
```

## src/modules/linux-micro/bluetooth/Kconfig
```kconfig
config LINUX_MICRO_BLUETOOTH
	tristate "bluetooth"
	depends on LINUX_MICRO
	default m if MODULES=y
	help
            Start and monitor bluetoothd (from BlueZ project). This
            daemon is required for most bluetooth connectivity on the
            Linux platform.
```
