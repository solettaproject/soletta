## src/modules/flow/calamari/Kconfig
```kconfig
config FLOW_NODE_TYPE_CALAMARI
	tristate "Node type: calamari"
	depends on FLOW_NODE_TYPE_GPIO && USE_PWM && USE_SPI
	default m
```

## src/modules/flow/converter/Kconfig
```kconfig
config FLOW_NODE_TYPE_CONVERTER
	tristate "Node type: converter"
	default y
	help
		The converter family of nodes will convert Soletta
		packets from one type to another (e.g. boolean to
		byte). Some of them will do more fancy things, like
		splitting a byte into (boolean) individual bits.
		Others will compose a final packet from others, like
		assembling four bytes into a final integer. You'll
		also find a node that splits an error packet in other
		two—its integer code and its string message. There are
		also the nodes dealing with JSON data (e.g. one that
		gets a string packet and outputs a JSON array packet,
		if the string is valid). Finally, there are some nodes
		converting some packet types to string packets,
		namely float-to-string and int-to-string. These last
		two have sibling nodes doing a more elaborate string
		formatting output, but they belong in another flow
		module: py-formatting.
```

## src/modules/flow/evdev/Kconfig
```kconfig
config FLOW_NODE_TYPE_EVDEV
	tristate "Node type: evdev"
	depends on PLATFORM_LINUX
	default m
```

## src/modules/flow/file/Kconfig
```kconfig
config FLOW_NODE_TYPE_FILE
	tristate "Node type: file"
	depends on FEATURE_FILESYSTEM && WORKER_THREAD
	default m
```

## src/modules/flow/filter-repeated/Kconfig
```kconfig
config FLOW_NODE_TYPE_FILTER_REPEATED
	tristate "Node type: filter-repeated"
	default y
```

## src/modules/flow/float/Kconfig
```kconfig
config FLOW_NODE_TYPE_FLOAT
	tristate "Node type: float"
	depends on FLOW
	default y
```

## src/modules/flow/flower-power/Kconfig
```kconfig
config FLOW_NODE_TYPE_FLOWER_POWER
	tristate "Node type: flower-power"
	depends on HTTP_CLIENT
	default m
	help
		Parrot Flower Power is a wireless plant monitor that measures
		and analyses the four elements crucial to plant's health:
		sunlight, temperature, soil moisture and fertilizer.

		Parrot Flower Power has API that allows to fetch plant's data
		via HTTP, using a web service, and API to talk directly to
		sensors using Bluetooth low energy (BLE).

		This option enables a few node types:

                  * flower-power/http-get, to query plant's data via http.
                  * flower-power/filter-id, to filter http-get packets
                    for specific plant's ids.
                  * flower-power/get-value, to parse packets with plant
                    information from other flower-power node types
                    into values of each measured element.
                  * flower-power/filter-sensor-id, to filter http-get packets
                    for specific sensor's ids.
                  * flower-power/get-sensor-value, to parse packets with
                    device information from other flower-power node types
                    into values of each measured element.

		To use these nodes, one must register and obtain an API key, that
		should be used as node options. To fetch plant's data, users
		must provide username and password, obtained also from Parrot
		site.
```

## src/modules/flow/form/Kconfig
```kconfig
config FLOW_NODE_TYPE_FORM
	tristate "Node type: form"
	default m
	help
		It is common to have IoT products with LCD display and
		buttons (arrows) and the need to ask for user input.
		This is a collection of high-level node types to deal
		with that, the *form* nodes.

		These node types format a multi-line string to be
		used by other node types doing visual output, such as
		LCD display (grove/lcd-string), in conjuntion with others
		providing input.

config PYTHON_FORMATTING
	bool "Build Python-like string formatting (string-formatted) nodes"
	depends on FLOW_NODE_TYPE_CONVERTER
	default y
	help
		Consider changing this if this functionality won't be used
		and the final Soletta binary is meant for constrained
		systems. Note that the string-formatted node is made useless
		if this is not set (any interaction with these nodes will
		lead to error packets).
```

## src/modules/flow/format/Kconfig
```kconfig
config FLOW_NODE_TYPE_FORMAT
	tristate "Node type: format"
	default m
	help
                The format family of nodes aggregates those nodes that
                make use of Python string-formatting code. We have the
                converter nodes, converting some packet types to
                string packets, namely float-to-string-format and
                int-to-string-format. They possess Python-like string
                formatting capabilities, as in
                https://docs.python.org/3/library/stdtypes.html#str.format.
                Those are meant to be used in place of their siblings
                on the converter family of nodes, when there is more
                processing power and ROM space. There's also the
                string-formatted-form node, that provides a form to
                control the formation/edition of a string.
```

## src/modules/flow/freegeoip/Kconfig
```kconfig
config FLOW_NODE_TYPE_FREEGEOIP
	tristate "Node type: freegeoip"
	depends on HTTP_CLIENT
	default m
	help
		Uses the free FreeGeoip service to obtain the location of
		either a given IP address or the originating address.  The
		service endpoint can be specified, but if omitted the
		official, free server at https://freegeoip.net will be used
		instead.

		If unsure, say Y.
```

## src/modules/flow/fs/Kconfig
```kconfig
config FLOW_NODE_TYPE_FS
	tristate "Node type: fs"
	depends on FEATURE_FILESYSTEM
	default m
```

## src/modules/flow/gpio/Kconfig
```kconfig
config FLOW_NODE_TYPE_GPIO
	tristate "Node type: gpio"
	depends on USE_GPIO
	default y
```

## src/modules/flow/grove/Kconfig
```kconfig
config FLOW_NODE_TYPE_GROVE
	tristate "Node type: grove"
	depends on FLOW_NODE_TYPE_AIO
	default m
```

## src/modules/flow/gtk/Kconfig
```kconfig
config FLOW_NODE_TYPE_GTK
	tristate "Node type: gtk"
	depends on LINUX && HAVE_GTK && HAVE_GLIB
	default m
```

## src/modules/flow/gyroscope/Kconfig
```kconfig
config FLOW_NODE_TYPE_GYROSCOPE
	tristate "Node type: gyroscope"
	depends on USE_I2C
	default m
```

## src/modules/flow/hc-sr04/Kconfig
```kconfig
config FLOW_NODE_TYPE_HC_SR04
	tristate "Node type: hc-sr04"
	depends on USE_GPIO
	default n
```

## src/modules/flow/http-client/Kconfig
```kconfig
config FLOW_NODE_TYPE_HTTP_CLIENT
	tristate "Node type: http_client"
	depends on HTTP_CLIENT
	default m
	help
		Provides an HTTP client node for basic packet types.
```

## src/modules/flow/http-server/Kconfig
```kconfig
config FLOW_NODE_TYPE_HTTP_SERVER
	tristate "Node type: http_server"
	depends on HTTP_SERVER
	default m
	help
		Provides an HTTP server for basic packet types.
```

## src/modules/flow/http/Kconfig
```kconfig
config FLOW_NODE_TYPE_HTTP
	tristate "Node type: http"
	depends on HTTP_CLIENT
	default m
	help
		Simple HTTP API to make requests.
```
