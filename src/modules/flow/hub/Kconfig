## src/modules/flow/hub/Kconfig
```kconfig
config FLOW_NODE_TYPE_HUB
	tristate "Node type: hub"
	depends on FLOW
	default y
```

## src/modules/flow/iio/Kconfig
```kconfig
config FLOW_NODE_TYPE_IIO
	tristate "Node type: iio"
	depends on USE_IIO
	default m
```

## src/modules/flow/ipm/Kconfig
```kconfig
config FLOW_NODE_TYPE_IPM
	tristate "Node type: IPM"
	depends on USE_IPM
	default y
```

## src/modules/flow/jhd1313m1/Kconfig
```kconfig
config FLOW_NODE_TYPE_JHD1313M1
	tristate "Node type: jhd1313m1"
	depends on USE_I2C
	default m
```

## src/modules/flow/json/Kconfig
```kconfig
config FLOW_NODE_TYPE_JSON
	tristate "Node type: json"
	default m
	help
		The JSON family of nodes provide JSON facilities
		to parse, create and debug JSON Objects and JSON Arrays
```

## src/modules/flow/keyboard/Kconfig
```kconfig
config FLOW_NODE_TYPE_KEYBOARD
	tristate "Node type: keyboard"
	depends on PLATFORM_LINUX
	default m
```

## src/modules/flow/lcd-grove/Kconfig
```kconfig
config FLOW_NODE_TYPE_LCD_GROVE
	tristate "Node type: lcd-grove"
	depends on FLOW
	default m
```

## src/modules/flow/led-7seg/Kconfig
```kconfig
config FLOW_NODE_TYPE_LED_7SEG
	tristate "Node type: led 7 segments"
	depends on USE_GPIO
	default y
```

## src/modules/flow/led-strip/Kconfig
```kconfig
config FLOW_NODE_TYPE_LED_STRIP
	tristate "Node type: led-strip"
	depends on USE_SPI
	default m
```

## src/modules/flow/location/Kconfig
```kconfig
config FLOW_NODE_TYPE_LOCATION
	tristate "Node type: location"
	depends on HTTP_CLIENT
	default y
	help
		Uses the free FreeGeoip service to obtain the location of
		either a given IP address or the originating address.  The
		service endpoint can be specified, but if omitted the
		official, free server at https://freegeoip.net will be used
		instead.

		If unsure, say Y.
```

## src/modules/flow/lsm9ds0/Kconfig
```kconfig
config FLOW_NODE_TYPE_LSM9DS0
	tristate "Node type: lsm9ds0"
	depends on USE_I2C
	default n
```

## src/modules/flow/magnetometer/Kconfig
```kconfig
config FLOW_NODE_TYPE_MAGNETOMETER
	tristate "Node type: magnetometer"
	depends on USE_I2C
	default m
```

## src/modules/flow/max31855/Kconfig
```kconfig
config FLOW_NODE_TYPE_MAX31855
	tristate "Node type: max31855"
	depends on USE_SPI
	default m
```

## src/modules/flow/mqtt/Kconfig
```kconfig
config FLOW_NODE_TYPE_MQTT
    tristate "Node type: MQTT"
    depends on MQTT
    default m
    help
        MQTT is a machine-to-machine (M2M)/"Internet of Things"
        connectivity protocol. It was designed as an extremely
        lightweight publish/subscribe messaging transport.

        This option enables the mqtt/client node type, which can
        be used to both publish messages and subscribe to topics
```

## src/modules/flow/netctl/Kconfig
```kconfig
config FLOW_NODE_TYPE_NETCTL
	tristate "Node type: netctl"
	depends on NETCTL
	default m
	help
		Network control is used to control the system network status. On Linux it will communicate with ConnMan via DBus
```

## src/modules/flow/network/Kconfig
```kconfig
config FLOW_NODE_TYPE_NETWORK
	tristate "Node type: network"
	depends on NETWORK
	default m
```

## src/modules/flow/oauth/Kconfig
```kconfig
config FLOW_NODE_TYPE_OAUTH
	tristate "Node type: oauth authenticator"
	depends on HTTP_CLIENT && HTTP_SERVER
	default m
	help
		Provides a HTTP OAUTH authentication
```

## src/modules/flow/oic/Kconfig
```kconfig
config FLOW_NODE_TYPE_OIC
	tristate "Node type: oic"
	depends on OIC && UNIX
	default m
```

## src/modules/flow/persistence/Kconfig
```kconfig
config FLOW_NODE_TYPE_PERSISTENCE
	tristate "Node type: persistence"
	depends on PLATFORM_LINUX && (USE_EFIVARS || USE_FILESYSTEM || USE_MEMMAP)
	default m
```

## src/modules/flow/piezo-speaker/Kconfig
```kconfig
config FLOW_NODE_TYPE_PIEZO_SPEAKER
	tristate "Node type: piezo-speaker"
	depends on USE_PWM
	default m
```

## src/modules/flow/platform/Kconfig
```kconfig
config FLOW_NODE_TYPE_PLATFORM
	tristate "Node type: platform"
        depends on PLATFORM_RIOTOS || PLATFORM_CONTIKI || PLATFORM_LINUX
	default y
```

## src/modules/flow/power-supply/Kconfig
```kconfig
config FLOW_NODE_TYPE_POWER_SUPPLY
	tristate "Node type: power-supply"
	depends on POWER_SUPPLY
	default m
	help
		Power supply is used to get information from battery, UPS,
		AC or DC power supplies.

		This option enables node types:

			* power-supply/get-list, to query the name of all
			  power supply attached to the board.
			* power-supply/get-capacity, to get batteries capacity.
```

## src/modules/flow/process/Kconfig
```kconfig
config FLOW_NODE_TYPE_PROCESS
	tristate "Node type: process"
	depends on UNIX
	default m
```
