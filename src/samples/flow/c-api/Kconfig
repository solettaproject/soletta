## src/samples/flow/c-api/Kconfig
```kconfig
config FLOW_C_API_CUSTOM_NODE_TYPES_SAMPLE
	bool
	depends on FLOW_SAMPLES
	default y

config FLOW_C_API_HIGHLEVEL_SAMPLE
	bool
	depends on NODE_DESCRIPTION && FLOW_NODE_TYPE_CONSOLE
	default y

config FLOW_C_API_LOWLEVEL_SAMPLE
	bool
	depends on FLOW_SAMPLES && FLOW_NODE_TYPE_CONSOLE
	default y

config FLOW_C_API_SIMPLE_C_TYPE_SAMPLE
	bool
	depends on SAMPLES && NODE_DESCRIPTION && FLOW_NODE_TYPE_CONSOLE && FLOW_NODE_TYPE_BOOLEAN && FLOW_NODE_TYPE_INT && FLOW_NODE_TYPE_TIMER
	default y

config FLOW_C_API_FIND_TYPE_SAMPLE
	bool
	depends on SAMPLES && RESOLVER_CONFFILE
	default y

config FLOW_C_API_SINGLE_NODE_SAMPLE
	bool
	depends on SAMPLES && NODE_DESCRIPTION && FLOW_NODE_TYPE_WALLCLOCK
	default y
```

## src/samples/flow/compass/Kconfig
```kconfig
config FLOW_COMPASS_LSM303_SAMPLE
	bool
	depends on FLOW_FBP_GENERATOR_SAMPLES && FLOW_NODE_TYPE_MAGNETOMETER && FLOW_NODE_TYPE_ACCELEROMETER && FLOW_NODE_TYPE_COMPASS && FLOW_NODE_TYPE_CONSOLE
	default y

config FLOW_COMPASS_ADXL45_SAMPLE
	bool
	depends on FLOW_FBP_GENERATOR_SAMPLES && FLOW_NODE_TYPE_ACCELEROMETER && FLOW_NODE_TYPE_TIMER && FLOW_NODE_TYPE_CONSOLE
	default y
```

## src/samples/flow/contiki-demo/Kconfig
```kconfig
config FLOW_CONTIKI_DEMO
	bool
	depends on FLOW_FBP_GENERATOR_SAMPLES
	default y
```

## src/samples/flow/foosball/Kconfig
```kconfig
config FLOW_FOOSBALL_SAMPLE
	bool
	depends on FLOW_FBP_GENERATOR_SAMPLES && FLOW_NODE_TYPE_GTK && FLOW_NODE_TYPE_CONSTANT && FLOW_NODE_TYPE_BOOLEAN && FLOW_NODE_TYPE_TIMER && FLOW_NODE_TYPE_INT && FLOW_NODE_TYPE_CONVERTER
	default y
```

## src/samples/flow/grove-kit/Kconfig
```kconfig
config FLOW_GROVE_BUTTON_SAMPLE
	bool
	depends on FLOW_FBP_GENERATOR_SAMPLES && FLOW_NODE_TYPE_GPIO
	default y

config FLOW_GROVE_BUZZER_SAMPLE
	bool
	depends on FLOW_FBP_GENERATOR_SAMPLES && FLOW_NODE_TYPE_PIEZO_SPEAKER && FLOW_NODE_TYPE_CONSTANT
	default y

config FLOW_GROVE_LED_ACCUMULATOR_SAMPLE
	bool
	depends on FLOW_FBP_GENERATOR_SAMPLES && FLOW_NODE_TYPE_CONSTANT && FLOW_NODE_TYPE_TIMER && FLOW_NODE_TYPE_INT && FLOW_NODE_TYPE_CONVERTER && FLOW_NODE_TYPE_BOOLEAN && FLOW_NODE_TYPE_PWM
	default y

config FLOW_GROVE_RELAY_SAMPLE
	bool
	depends on FLOW_FBP_GENERATOR_SAMPLES && FLOW_NODE_TYPE_GPIO
	default y

config FLOW_GROVE_SOUND_SENSOR_SAMPLE
	bool
	depends on FLOW_FBP_GENERATOR_SAMPLES && FLOW_NODE_TYPE_CONSTANT && FLOW_NODE_TYPE_INT && FLOW_NODE_TYPE_AIO && FLOW_NODE_TYPE_GPIO
	default y

config FLOW_GROVE_LED_WAVE_GENERATOR_SAMPLE
	bool
	depends on FLOW_FBP_GENERATOR_SAMPLES && FLOW_NODE_TYPE_CONSTANT && FLOW_NODE_TYPE_TIMER && FLOW_NODE_TYPE_FLOAT && FLOW_NODE_TYPE_CONVERTER && FLOW_NODE_TYPE_PWM
	default y

config FLOW_GROVE_LIGHT_SENSOR_SAMPLE
	bool
	depends on FLOW_FBP_GENERATOR_SAMPLES && FLOW_NODE_TYPE_CONVERTER && FLOW_NODE_TYPE_GPIO && FLOW_NODE_TYPE_GROVE
	default y

config FLOW_GROVE_ROTARY_ANGLE_SENSOR_SAMPLE
	bool
	depends on FLOW_FBP_GENERATOR_SAMPLES && FLOW_NODE_TYPE_GPIO && FLOW_NODE_TYPE_CONVERTER && FLOW_NODE_TYPE_CONSTANT && FLOW_NODE_TYPE_GROVE
	default y

config FLOW_GROVE_THERMOMETER_SAMPLE
	bool
	depends on FLOW_FBP_GENERATOR_SAMPLES && FLOW_NODE_TYPE_INT && FLOW_NODE_TYPE_CONSTANT && FLOW_NODE_TYPE_GPIO && FLOW_NODE_TYPE_AIO && FLOW_NODE_TYPE_CONVERTER && FLOW_NODE_TYPE_STRING && FLOW_NODE_TYPE_GROVE && FLOW_NODE_TYPE_TEMPERATURE
	default y
```

## src/samples/flow/grove-kit/lcd/Kconfig
```kconfig
config FLOW_GROVE_LCD_AUTOSCROLL_SAMPLE
	bool
	depends on FLOW_NODE_TYPE_JHD1313M1 && FLOW_FBP_GENERATOR_SAMPLES && FLOW_NODE_TYPE_GROVE && FLOW_NODE_TYPE_CONSTANT && FLOW_NODE_TYPE_BOOLEAN && FLOW_NODE_TYPE_INT && FLOW_NODE_TYPE_TIMER && FLOW_NODE_TYPE_CONVERTER && FLOW_NODE_TYPE_GROVE
	default y

config FLOW_GROVE_LCD_BLINK_SAMPLE
	bool
	depends on FLOW_NODE_TYPE_JHD1313M1 && FLOW_FBP_GENERATOR_SAMPLES && FLOW_NODE_TYPE_GROVE && FLOW_NODE_TYPE_CONSTANT && BOOLEAN && FLOW_NODE_TYPE_TIMER && FLOW_NODE_TYPE_CONVERTER
	default y

config FLOW_GROVE_LCD_CURSOR_SAMPLE
	bool
	depends on FLOW_NODE_TYPE_JHD1313M1 && FLOW_FBP_GENERATOR_SAMPLES && FLOW_NODE_TYPE_GROVE && FLOW_NODE_TYPE_CONSTANT && FLOW_NODE_TYPE_BOOLEAN && FLOW_NODE_TYPE_TIMER && FLOW_NODE_TYPE_CONVERTER
	default y

config FLOW_GROVE_LCD_DISPLAY_SAMPLE
	bool
	depends on FLOW_NODE_TYPE_JHD1313M1 && FLOW_FBP_GENERATOR_SAMPLES && FLOW_NODE_TYPE_GROVE && FLOW_NODE_TYPE_CONSTANT && FLOW_NODE_TYPE_BOOLEAN && FLOW_NODE_TYPE_TIMER
	default y

config FLOW_GROVE_LCD_HELLO_WORLD_SAMPLE
	bool
	depends on FLOW_NODE_TYPE_JHD1313M1 && FLOW_FBP_GENERATOR_SAMPLES && FLOW_NODE_TYPE_GROVE && FLOW_NODE_TYPE_CONSTANT && FLOW_NODE_TYPE_TIMER && FLOW_NODE_TYPE_CONVERTER && FLOW_NODE_TYPE_INT
	default y

config FLOW_GROVE_LCD_SCROLL_SAMPLE
	bool
	depends on FLOW_NODE_TYPE_JHD1313M1 && FLOW_FBP_GENERATOR_SAMPLES && FLOW_NODE_TYPE_GROVE && FLOW_NODE_TYPE_CONSTANT && FLOW_NODE_TYPE_INT && FLOW_NODE_TYPE_TIMER && FLOW_NODE_TYPE_CONVERTER && FLOW_NODE_TYPE_BOOLEAN
	default y

config FLOW_GROVE_LCD_SET_CURSOR_SAMPLE
	bool
	depends on FLOW_NODE_TYPE_JHD1313M1 && FLOW_FBP_GENERATOR_SAMPLES && FLOW_NODE_TYPE_GROVE && FLOW_NODE_TYPE_TIMER && FLOW_NODE_TYPE_INT && FLOW_NODE_TYPE_CONVERTER && FLOW_NODE_TYPE_CONSTANT
	default y

config FLOW_GROVE_LCD_TEXT_DIRECTION_SAMPLE
	bool
	depends on FLOW_NODE_TYPE_JHD1313M1 && FLOW_FBP_GENERATOR_SAMPLES && FLOW_NODE_TYPE_GROVE && FLOW_NODE_TYPE_TIMER && FLOW_NODE_TYPE_INT && FLOW_NODE_TYPE_CONVERTER && FLOW_NODE_TYPE_CONSTANT && FLOW_NODE_TYPE_BOOLEAN
	default y

config FLOW_GROVE_LCD_FADE_SAMPLE
	bool
	depends on FLOW_NODE_TYPE_JHD1313M1 && FLOW_FBP_GENERATOR_SAMPLES && FLOW_NODE_TYPE_GROVE && FLOW_NODE_TYPE_TIMER && FLOW_NODE_TYPE_CONVERTER && FLOW_NODE_TYPE_CONSTANT && FLOW_NODE_TYPE_FLOAT
	default y

config FLOW_GROVE_LCD_FORM_SAMPLE
	bool
	depends on FLOW_NODE_TYPE_JHD1313M1 && FLOW_FBP_GENERATOR_SAMPLES && FLOW_NODE_TYPE_GROVE && FLOW_NODE_TYPE_FORM && FLOW_NODE_TYPE_KEYBOARD && FLOW_NODE_TYPE_CONSTANT && FLOW_NODE_TYPE_TIMER && FLOW_NODE_TYPE_CONVERTER
	default y
```

## src/samples/flow/gtk-gallery/Kconfig
```kconfig
config FLOW_GTK_GALLERY_SAMPLE
	bool
	depends on FLOW_FBP_GENERATOR_SAMPLES && FLOW_NODE_TYPE_GTK
	default y
```

## src/samples/flow/http-client/Kconfig
```kconfig
config FLOW_HTTP_CLIENT_SAMPLE
	bool
	depends on FLOW_FBP_GENERATOR_SAMPLES && FLOW_NODE_TYPE_HTTP_CLIENT && FLOW_NODE_TYPE_CONSOLE && FLOW_NODE_TYPE_CONSTANT && FLOW_NODE_TYPE_APP && FLOW_NODE_TYPE_FILE
	default y
```

## src/samples/flow/http-composed/Kconfig
```kconfig
config FLOW_HTTP_COMPOSED_SAMPLE
	bool
	depends on FLOW_FBP_GENERATOR_SAMPLES && FLOW_METATYPE_HTTP_COMPOSED_SERVER && FLOW_METATYPE_HTTP_COMPOSED_CLIENT && FLOW_NODE_TYPE_CONSOLE && FLOW_NODE_TYPE_CONSTANT
	default y
```

## src/samples/flow/http-json/Kconfig
```kconfig
config FLOW_HTTP_JSON_SAMPLE
	bool
	depends on FLOW_FBP_GENERATOR_SAMPLES && FLOW_NODE_TYPE_HTTP_CLIENT && FLOW_NODE_TYPE_JSON && FLOW_NODE_TYPE_CONSTANT && FLOW_NODE_TYPE_TEMPERATURE && FLOW_NODE_TYPE_CONSTANT && FLOW_NODE_TYPE_SWITCHER && FLOW_NODE_TYPE_STRING && FLOW_NODE_TYPE_CONVERTER && FLOW_NODE_TYPE_APP && FLOW_NODE_TYPE_CONSOLE && FLOW_NODE_TYPE_LOCATION
	default y
```

## src/samples/flow/http-oauth/Kconfig
```kconfig
config FLOW_HTTP_OAUTH_TWITTER_SAMPLE
	bool
	depends on FLOW_FBP_GENERATOR_SAMPLES && FLOW_NODE_TYPE_HTTP_SERVER && FLOW_NODE_TYPE_OAUTH && FLOW_NODE_TYPE_TWITTER && FLOW_NODE_TYPE_CONSOLE
	default y
```

## src/samples/flow/http-server/Kconfig
```kconfig
config FLOW_HTTP_SERVER_SAMPLE
	bool
	depends on FLOW_FBP_GENERATOR_SAMPLES && FLOW_NODE_TYPE_HTTP_SERVER && FLOW_NODE_TYPE_KEYBOARD && FLOW_NODE_TYPE_CONSOLE
	default y
```

## src/samples/flow/iio+network/Kconfig
```kconfig
config FLOW_IIO_NETWORK_SAMPLE
	bool
	depends on FLOW_FBP_GENERATOR_SAMPLES && FLOW_NODE_TYPE_IIO && FLOW_NODE_TYPE_TIMER && FLOW_NODE_TYPE_CONSOLE && FLOW_NODE_TYPE_MQTT && FLOW_NODE_TYPE_STRING && FLOW_NODE_TYPE_CONVERTER
	default y
```

## src/samples/flow/iio/Kconfig
```kconfig
config FLOW_IIO_SAMPLE
	bool
	depends on FLOW_FBP_GENERATOR_SAMPLES && FLOW_NODE_TYPE_IIO && FLOW_NODE_TYPE_TIMER && FLOW_NODE_TYPE_CONSOLE
	default y
```

## src/samples/flow/io/Kconfig
```kconfig
config FLOW_IO_SAMPLE
	bool
	depends on FLOW_FBP_GENERATOR_SAMPLES && FLOW_NODE_TYPE_PWM && FLOW_NODE_TYPE_SERVO_MOTOR && FLOW_NODE_TYPE_INT && FLOW_NODE_TYPE_TIMER && FLOW_NODE_TYPE_CONSOLE && FLOW_NODE_TYPE_CONVERTER && FLOW_NODE_TYPE_BOOLEAN
	default y
```

## src/samples/flow/js/Kconfig
```kconfig
config FLOW_TELEGRAM_JS_SAMPLE
	bool
	depends on FLOW_FBP_GENERATOR_SAMPLES && FLOW_METATYPE_JAVASCRIPT && FLOW_NODE_TYPE_CONSTANT && FLOW_NODE_TYPE_CONSOLE
	default y

config FLOW_MY_COUNTER_JS_SAMPLE
	bool
	depends on FLOW_FBP_GENERATOR_SAMPLES && FLOW_METATYPE_JAVASCRIPT && FLOW_NODE_TYPE_TIMER && FLOW_NODE_TYPE_BOOLEAN && FLOW_NODE_TYPE_CONSOLE
	default y

config FLOW_ATTENDEE_JS_SAMPLE
	bool
	depends on FLOW_FBP_GENERATOR_SAMPLES && FLOW_METATYPE_JAVASCRIPT && FLOW_NODE_TYPE_INT && FLOW_NODE_TYPE_CONSTANT && FLOW_NODE_TYPE_BOOLEAN && FLOW_NODE_TYPE_GTK
	default y
```

## src/samples/flow/led-strip/Kconfig
```kconfig
config FLOW_LD_STRIP_LPD8806_SAMPLE
	bool
	depends on FLOW_FBP_GENERATOR_SAMPLES && FLOW_NODE_TYPE_LED_STRIP && FLOW_NODE_TYPE_INT && FLOW_NODE_TYPE_CONVERTER && FLOW_NODE_TYPE_BOOLEAN && FLOW_NODE_TYPE_RANDOM && FLOW_NODE_TYPE_TIMER
	default y
```

## src/samples/flow/minnow-calamari/Kconfig
```kconfig
config FLOW_CALAMARI_7SEG_SEGMENTS_SAMPLE
	bool
	depends on FLOW_FBP_GENERATOR_SAMPLES && FLOW_NODE_TYPE_CALAMARI && FLOW_NODE_TYPE_TIMER && FLOW_NODE_TYPE_INT && FLOW_NODE_TYPE_SWITCHER && FLOW_NODE_TYPE_CONSTANT && FLOW_NODE_TYPE_LED_7SEG
	default y

config FLOW_CALAMARI_7SEG_VALUE_SAMPLE
	bool
	depends on FLOW_FBP_GENERATOR_SAMPLES && FLOW_NODE_TYPE_CALAMARI && FLOW_NODE_TYPE_INT && FLOW_NODE_TYPE_WALLCLOCK && FLOW_NODE_TYPE_LED_7SEG
	default y

config FLOW_CALAMARI_BUTTONS_RGB_LED_SAMPLE
	bool
	depends on FLOW_FBP_GENERATOR_SAMPLES && FLOW_NODE_TYPE_CALAMARI && FLOW_NODE_TYPE_CONSOLE && FLOW_NODE_TYPE_GPIO
	default y

config FLOW_CALAMARI_LED_SAMPLE
	bool
	depends on FLOW_FBP_GENERATOR_SAMPLES && FLOW_NODE_TYPE_CALAMARI
	default y

config FLOW_CALAMARI_LEVER_SAMPLE
	bool
	depends on FLOW_FBP_GENERATOR_SAMPLES && FLOW_NODE_TYPE_CALAMARI
	default y

config FLOW_CALAMARI_RGB_LED_SAMPLE
	bool
	depends on FLOW_FBP_GENERATOR_SAMPLES && FLOW_NODE_TYPE_CALAMARI && FLOW_NODE_TYPE_WALLCLOCK && FLOW_NODE_TYPE_INT && FLOW_NODE_TYPE_CONVERTER && FLOW_NODE_TYPE_GPIO
	default y

config FLOW_CALAMARI_BUTTON_ACCUMULATOR_PERSISTENCE
	bool
	depends on FLOW_FBP_GENERATOR_SAMPLES && FLOW_NODE_TYPE_CALAMARI && FLOW_NODE_TYPE_PERSISTENCE && FLOW_NODE_TYPE_INT && FLOW_NODE_TYPE_BOOLEAN && FLOW_NODE_TYPE_GPIO
	default y

config FLOW_CALAMARI_BUTTON_ACCUMULATOR_PERSISTENCE_EFIVARS
	bool
	depends on FLOW_FBP_GENERATOR_SAMPLES && FLOW_NODE_TYPE_CALAMARI && FLOW_NODE_TYPE_PERSISTENCE && FLOW_NODE_TYPE_INT && FLOW_NODE_TYPE_BOOLEAN && FLOW_NODE_TYPE_GPIO
	default y
```

## src/samples/flow/misc/Kconfig
```kconfig
config FLOW_MISC_FILE_COPY_SAMPLE
	bool
	depends on FLOW_FBP_GENERATOR_SAMPLES && FLOW_NODE_TYPE_TIMER && FLOW_NODE_TYPE_CONSTANT && FLOW_NODE_TYPE_APP && FLOW_NODE_TYPE_CONSOLE && FLOW_NODE_TYPE_INT && FLOW_NODE_TYPE_FILEFLOW_NODE_TYPE_CONVERTER
	default y

config FLOW_MISC_RANDOM_NUMBERS_SAMPLE
	bool
	depends on FLOW_FBP_GENERATOR_SAMPLES && FLOW_NODE_TYPE_TIMER && FLOW_NODE_TYPE_RANDOM && FLOW_NODE_TYPE_CONSOLE
	default y

config FLOW_MISC_TICKETS_QUEUE_SAMPLE
	bool
	depends on FLOW_FBP_GENERATOR_SAMPLES && FLOW_NODE_TYPE_KEYBOARD && FLOW_NODE_TYPE_INT && FLOW_NODE_TYPE_CONSOLE && FLOW_NODE_TYPE_CONVERTER && FLOW_NODE_TYPE_BOOLEAN
	default y

config FLOW_MISC_PERSISTENCE_SAMPLE
	bool
	depends on FLOW_FBP_GENERATOR_SAMPLES && FLOW_NODE_TYPE_PERSISTENCE && FLOW_NODE_TYPE_TIMER && FLOW_NODE_TYPE_BOOLEAN && FLOW_NODE_TYPE_WALLCLOCK && FLOW_NODE_TYPE_CONVERTER && FLOW_NODE_TYPE_CONSOLE
	default y

config FLOW_MISC_CHANGE_HOSTNAME_SAMPLE
	bool
	depends on FLOW_FBP_GENERATOR_SAMPLES && FLOW_NODE_TYPE_CONSTANT && FLOW_NODE_TYPE_STRING && FLOW_NODE_TYPE_APP && FLOW_NODE_TYPE_PLATFORM && FLOW_NODE_TYPE_CONSOLE
	default y

config FLOW_MISC_CHANGE_TIMEZONE_SAMPLE
	bool
	depends on FLOW_FBP_GENERATOR_SAMPLES && FLOW_NODE_TYPE_CONSTANT && FLOW_NODE_TYPE_STRING && FLOW_NODE_TYPE_APP && FLOW_NODE_TYPE_PLATFORM && FLOW_NODE_TYPE_CONSOLE
	default y

config FLOW_MISC_CHANGE_SYSTEM_CLOCK_SAMPLE
	bool
	depends on FLOW_FBP_GENERATOR_SAMPLES && FLOW_NODE_TYPE_CONSTANT && FLOW_NODE_TYPE_STRING && FLOW_NODE_TYPE_APP && FLOW_NODE_TYPE_PLATFORM && FLOW_NODE_TYPE_CONSOLE && FLOW_NODE_TYPE_CONVERTER
	default y

config FLOW_MISC_CHANGE_LOCALE_SAMPLE
	bool
	depends on FLOW_FBP_GENERATOR_SAMPLES && FLOW_NODE_TYPE_CONSTANT && FLOW_NODE_TYPE_STRING && FLOW_NODE_TYPE_APP && FLOW_NODE_TYPE_PLATFORM && FLOW_NODE_TYPE_CONSOLE
	default y

config FLOW_MISC_EVDEV_SAMPLE
	bool
	depends on FLOW_FBP_GENERATOR_SAMPLES && FLOW_NODE_TYPE_EVDEV && FLOW_NODE_TYPE_CONSOLE
	default y

config FLOW_MISC_NET_STATUS_SAMPLE
	bool
	depends on FLOW_FBP_GENERATOR_SAMPLES && FLOW_NODE_TYPE_NETWORK && FLOW_NODE_TYPE_CONSOLE && FLOW_NODE_TYPE_APP
	default y

config FLOW_MISC_UDEV_SAMPLE
	bool
	depends on FLOW_FBP_GENERATOR_SAMPLES && FLOW_NODE_TYPE_UDEV && FLOW_NODE_TYPE_CONSOLE
	default y
```

## src/samples/flow/mqtt/Kconfig
```kconfig
config FLOW_MQTT_SAMPLE
	bool
	depends on FLOW_FBP_GENERATOR_SAMPLES && FLOW_NODE_TYPE_MQTT && FLOW_NODE_TYPE_CONSOLE && FLOW_NODE_TYPE_CONSTANT && FLOW_NODE_TYPE_CONVERTER && FLOW_NODE_TYPE_TIMER
	default y
```

## src/samples/flow/netctl/Kconfig
```kconfig
config FLOW_NETCTL_SAMPLE
	bool
	depends on FLOW_FBP_GENERATOR_SAMPLES && FLOW_NODE_TYPE_NETCTL && FLOW_NODE_TYPE_CONSOLE && FLOW_NODE_TYPE_CONSTANT && FLOW_NODE_TYPE_APP && FLOW_NODE_TYPE_CONVERTER && FLOW_NODE_TYPE_TIMER
	default y
```

## src/samples/flow/oic-and-http-light/Kconfig
```kconfig
config FLOW_OIC_AND_HTTP_LIGHT_SAMPLE
	bool
	depends on FLOW_FBP_GENERATOR_SAMPLES && FLOW_NODE_TYPE_OIC && FLOW_NODE_TYPE_HTTP_CLIENT && FLOW_NODE_TYPE_HTTP_SERVER && FLOW_NODE_TYPE_CONSOLE && FLOW_NODE_TYPE_TIMER && FLOW_NODE_TYPE_APP && FLOW_NODE_TYPE_CONSTANT && FLOW_NODE_TYPE_CONVERTER && FLOW_NODE_TYPE_PLATFORM && FLOW_NODE_TYPE_PERSISTENCE && FLOW_NODE_TYPE_INT && FLOW_NODE_TYPE_STRING && FLOW_NODE_TYPE_KEYBOARD
	default y
```

## src/samples/flow/oic/Kconfig
```kconfig
config FLOW_OIC_SAMPLE
	bool
	depends on FLOW_FBP_GENERATOR_SAMPLES && FLOW_NODE_TYPE_OIC && FLOW_NODE_TYPE_TIMER && FLOW_NODE_TYPE_CONSOLE && FLOW_NODE_TYPE_BOOLEAN && FLOW_NODE_TYPE_CONSTANT
	default y
```

## src/samples/flow/oic/light-scan/Kconfig
```kconfig
config FLOW_OIC_SCAN_SAMPLE
	bool
	depends on FLOW_FBP_GENERATOR_SAMPLES && FLOW_NODE_TYPE_OIC && FLOW_NODE_TYPE_GTK && FLOW_NODE_TYPE_CONSTANT && FLOW_NODE_TYPE_FORM && FLOW_NODE_TYPE_TIMER && FLOW_NODE_TYPE_CONVERTER && FLOW_NODE_TYPE_BOOLEAN && FLOW_NODE_TYPE_PERSISTENCE
	default y
```

## src/samples/flow/power-supply/Kconfig
```kconfig
config FLOW_POWER_SUPPLY_SAMPLE
	bool
	depends on FLOW_FBP_GENERATOR_SAMPLES && FLOW_NODE_TYPE_POWER_SUPPLY && FLOW_NODE_TYPE_GTK && FLOW_NODE_TYPE_APP && FLOW_NODE_TYPE_TIMER && FLOW_NODE_TYPE_STRING && FLOW_NODE_TYPE_BOOLEAN && FLOW_NODE_TYPE_CONVERTER && FLOW_NODE_TYPE_CONSOLE && FLOW_NODE_TYPE_CONSTANT
	default y
```
