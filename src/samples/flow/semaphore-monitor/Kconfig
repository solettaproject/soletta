## src/samples/flow/semaphore-monitor/Kconfig
```kconfig
config FLOW_SEMAPHORE_MONITOR_SEMAPHORE_MONITOR_CONSOLE_SAMPLE
        bool
        depends on FLOW_FBP_GENERATOR_SAMPLES && FLOW_NODE_TYPE_HTTP_CLIENT && FLOW_NODE_TYPE_STRING && FLOW_NODE_TYPE_CONSOLE && FLOW_NODE_TYPE_TIMER && FLOW_NODE_TYPE_CONSTANT
        default y
```

## src/samples/flow/tilt-angle/Kconfig
```kconfig
config FLOW_TILT_ANGLE_ARCTANGENT_NODE
	tristate "Node type: arctangent"
	depends on FLOW_SAMPLES
	default m

config FLOW_TILT_ANGLE_SAMPLE
	bool
	depends on FLOW_FBP_GENERATOR_SAMPLES && FLOW_NODE_TYPE_IIO && FLOW_NODE_TYPE_CONSOLE && FLOW_NODE_TYPE_CONVERTER && FLOW_NODE_TYPE_FLOAT && FLOW_NODE_TYPE_CONSTANT && FLOW_NODE_TYPE_STRING && FLOW_TILT_ANGLE_ARCTANGENT_NODE
	default y
```

## src/samples/flow/trash-disposer/Kconfig
```kconfig
config FLOW_TRASH_DISPOSER
	bool
	depends on FLOW_FBP_GENERATOR_SAMPLES && FLOW_NODE_TYPE_SERVO_MOTOR && FLOW_NODE_TYPE_GPIO && FLOW_NODE_TYPE_TIMER && FLOW_NODE_TYPE_CONVERTER && FLOW_NODE_TYPE_CONSTANT && FLOW_NODE_TYPE_BOOLEAN
	default y
```

## src/samples/flow/unix-socket/Kconfig
```kconfig
config FLOW_UNIX_SOCKET_SAMPLE
	bool
	depends on FLOW_FBP_GENERATOR_SAMPLES && FLOW_NODE_TYPE_UNIX_SOCKET && FLOW_NODE_TYPE_KEYBOARD && FLOW_NODE_TYPE_CONSOLE && FLOW_NODE_TYPE_CONVERTER && FLOW_NODE_TYPE_TIMER && FLOW_NODE_TYPE_INT && FLOW_NOTE_TYPE_CONSTANT
	default y
```

## src/samples/flow/update/Kconfig
```kconfig
config FLOW_UPDATE_SAMPLE
	bool
	depends on FLOW_FBP_GENERATOR_SAMPLES && FLOW_NODE_TYPE_UPDATE && FLOW_NODE_TYPE_TIMER && FLOW_NODE_TYPE_CONSOLE && FLOW_NODE_TYPE_CONSTANT && FLOW_NODE_TYPE_CONVERTER
	default y
```

## src/samples/flow/webservices/Kconfig
```kconfig
config FLOW_WEBSERVICES_FLOWER_POWER_SAMPLE
	bool
	depends on FLOW_FBP_GENERATOR_SAMPLES && FLOW_NODE_TYPE_FLOWER_POWER && FLOW_NODE_TYPE_APP && FLOW_NODE_TYPE_CONSOLE && FLOW_NODE_TYPE_TIMER
	default y

config FLOW_WEBSERVICES_FREEGEO_IP_SAMPLE
	bool
	depends on FLOW_FBP_GENERATOR_SAMPLES && FLOW_NODE_TYPE_LOCATION && FLOW_NODE_TYPE_CONSTANT && FLOW_NODE_TYPE_CONSOLE
	default y

config FLOW_WEBSERVICES_THINGSPEAK_IDENTIFY_SAMPLE
	bool
	depends on FLOW_FBP_GENERATOR_SAMPLES && FLOW_NODE_TYPE_THINGSPEAK && FLOW_NODE_TYPE_CONVERTER && FLOW_NODE_TYPE_KEYBOARD && FLOW_NODE_TYPE_CONSOLE
	default y

config FLOW_WEBSERVICES_THINGSPEAK_SMART_LOCK_SAMPLE
	bool
	depends on FLOW_FBP_GENERATOR_SAMPLES && FLOW_NODE_TYPE_THINGSPEAK && FLOW_NODE_TYPE_CONVERTER && FLOW_NODE_TYPE_CONSTANT && FLOW_NODE_TYPE_CONSOLE && FLOW_NODE_TYPE_TIMER && FLOW_NODE_TYPE_STRING && FLOW_NODE_TYPE_BOOLEAN
	default y

config FLOW_WEBSERVICES_THINGSPEAK_CHANNEL_UPDATE_SAMPLE
	bool
	depends on FLOW_FBP_GENERATOR_SAMPLES && FLOW_NODE_TYPE_THINGSPEAK && FLOW_NODE_TYPE_CONSOLE && FLOW_NODE_TYPE_SWITCHER && FLOW_NODE_TYPE_CONVERTER && FLOW_NODE_TYPE_CONSTANT && FLOW_NODE_TYPE_INT && FLOW_NODE_TYPE_RANDOM && FLOW_NODE_TYPE_TIMER
	default y
```

## src/samples/http/Kconfig
```kconfig
config HTTP_SAMPLES
	depends on SAMPLES
	bool "HTTP samples"
	default y

config DOWNLOAD_SAMPLE
	bool "Download sample"
	depends on HTTP_SAMPLES && HTTP_CLIENT
	default y

config CLIENT_SAMPLE
	bool "Client sample"
	depends on HTTP_SAMPLES && HTTP_CLIENT
	default y

config STATIC_FILES_SAMPLE
	bool "Serve static files sample"
	depends on HTTP_SAMPLES && HTTP_SERVER && USE_FILESYSTEM
	default y

config SERVER_SAMPLE
	bool "Server sample"
	depends on HTTP_SAMPLES && HTTP_SERVER
	default y

config SERVER_SSE_SAMPLE
	bool "Server sent events sample"
	depends on HTTP_SAMPLES && HTTP_SERVER
	default y

config SERVER_HTTPS_SAMPLE
	bool "HTTPS server sample"
	depends on HTTP_SAMPLES && HTTP_SERVER
	default y
```

## src/samples/iio+network/Kconfig
```kconfig
config IIO_NETWORK_SAMPLES
	bool "IIO Network samples"
	depends on NETWORK && USE_IIO && SAMPLES
	default y

config IIO_MQTT_SAMPLES
	bool "IIO MQTT samples"
	depends on IIO_NETWORK_SAMPLES && MQTT
	default y
```

## src/samples/mavlink/Kconfig
```kconfig
config MAVLINK_SAMPLES
	bool "Mavlink samples"
	depends on MAVLINK && SAMPLES
	default y

config MAVLINK_BASIC
	bool "Basic mavlink sample"
	depends on MAVLINK_SAMPLES
	default y
	help
            This sample program demonstrates how to interact with the
            Mavlink API. It simply takes off a vehicle and then lands when
            reached the expected altitude.

config MAVLINK_GOTO
	bool "Goto location sample"
	depends on MAVLINK_SAMPLES
	default y
	help
            This sample program demonstrates how to interact with the
            Mavlink API. It takes off a vehicle and drivers to a given
            location, when reached the expected location and altitude
            it goes back/lands to the "home location".
```

## src/samples/mqtt/Kconfig
```kconfig
config MQTT_SAMPLES
	bool "MQTT samples"
	depends on MQTT && SAMPLES
	default y

config MQTT_PUBLISH_SUBSCRIBE_SAMPLES
	bool "MQTT publish/subscribe samples"
	depends on MQTT_SAMPLES
	default y
```

## src/samples/network/Kconfig
```kconfig
config NETWORK_SAMPLES
	bool "Network samples"
        depends on NETWORK && SAMPLES
	default y

config NETWORK_STATUS_SAMPLE
	bool "Network status"
	depends on NETWORK_SAMPLES
	default y

config ECHO_SERVER_SAMPLE
	bool "Echo server"
	depends on NETWORK_SAMPLES && NETWORK
	default y

config ECHO_CLIENT_SAMPLE
	bool "Echo client"
	depends on NETWORK_SAMPLES && NETWORK
	default y

config NETCTL_SAMPLE
	bool "Network control"
	depends on NETWORK_SAMPLES && NETCTL
```

## src/shared/Kconfig
```kconfig
config INTERNAL_SHARED
	tristate
	default m

config PTHREAD
	bool "Pthread"
	depends on HAVE_PTHREAD && SOL_PLATFORM_LINUX
	default y
```

## src/test/Kconfig
```kconfig
config TEST_ARENA
	bool "arena"
	default y

config TEST_MEMDESC
	bool "memdesc"
	default y

config TEST_BUFFER
	bool "buffer"
	default y

config TEST_COAP
	bool "coap"
	depends on COAP
	default y

config TEST_FBP
	bool "fbp"
	depends on USE_FLOW
	default y

config TEST_FBP_SCANNER
	bool "fbp scanner"
	depends on USE_FLOW
	default y

config TEST_FLOW
	bool "flow"
	depends on USE_FLOW && FLOW_NODE_TYPE_INT && FLOW_NODE_TYPE_TIMER
	default y

config TEST_FLOW_BUILDER
	bool "flow builder"
	depends on NODE_DESCRIPTION
	default y

config TEST_FLOW_PARSER
	bool "flow parser"
	depends on NODE_DESCRIPTION
	default y

config TEST_JAVASCRIPT
	bool "javascript"
	depends on FLOW_METATYPE_JAVASCRIPT
	default y

config TEST_MAINLOOP
	bool "mainloop"
	default y

config TEST_MAINLOOP_LINUX
	bool "mainloop linux"
	depends on PLATFORM_LINUX
	default y

config TEST_MAINLOOP_IMPLEMENTATION
	bool "mainloop implementation"
	default y

config TEST_MAINLOOP_THREADS
	bool "mainloop threads"
	depends on PTHREAD && MAINLOOP_POSIX
	default y

config TEST_MAINLOOP_THREADS_SOL_RUN
	bool "mainloop threads sol run"
	depends on PTHREAD && MAINLOOP_POSIX
	default y

config TEST_MAINLOOP_GLIB_INTEGRATION
	bool "mainloop glib integration"
	depends on LINUX && HAVE_GLIB
	default y

config TEST_MONITORS
	bool "monitors"
	default y

config TEST_STR_SLICE
	bool "str-slice"
	default y

config TEST_STR_SPLIT
	bool "str-split"
	default y

config TEST_STR_TABLE
	bool "str-table"
	default y

config TEST_VECTOR
	bool "vector"
	default y

config TEST_LIST
    bool "list"
    default y

config TEST_JSON
	bool "json"
	default y

config TEST_UTIL
	bool "util"
	default y

config TEST_UTIL_FILE
       bool "util-file"
       depends on FEATURE_FILESYSTEM
       default y

config TEST_COMPOSED_TYPE
	bool "composed-type"
	depends on USE_FLOW
	default y

config TEST_MESSAGE_DIGEST
      bool "crypto message-digest"
      default y

config TEST_PERSISTENCE_MEMMAP
	bool "Memmap persistence API"
	depends on USE_MEMMAP
	default y

config TEST_HTTP
       bool "http"
       depends on HTTP
       default y

config TEST_CERTIFICATE
    bool "Certificate API"
    depends on PLATFORM_LINUX
    default y

config TEST_LWM2M
       bool "lwm2m"
       depends on COAP && LWM2M
       default y

config TEST_NETWORK
       bool "network"
       depends on NETWORK && BLUETOOTH
       default y

config TEST_BLUETOOTH
       bool "bluetooth"
       depends on NETWORK && BLUETOOTH
       default y
```

## tools/build/Kconfig.contiki
```kconfig
config CONTIKI
    def_bool y
    select FEATURE_COAP
    select FEATURE_FLOW
    select FEATURE_HW_GPIO
    select FEATURE_HW_GPIO if HAVE_QMSI
    select FEATURE_HW_I2C if HAVE_QMSI
    select FEATURE_HW_PWM if HAVE_QMSI
    select FEATURE_HW_SPI if HAVE_QMSI
    select FEATURE_NETWORK
    select FEATURE_PIN_MUX if HAVE_QMSI
```

## tools/build/Kconfig.features
```kconfig
config FEATURE_DYNAMIC_LINKER
    bool

config FEATURE_RUNNABLE_PROGRAMS
    bool

config FEATURE_WORKER_THREADS
    bool

config FEATURE_UNIX_SOCKETS
    bool

config FEATURE_NETWORK
    bool

config FEATURE_COAP
    bool

config FEATURE_HTTP_CLIENT
    bool

config FEATURE_HW_AIO
    bool

config FEATURE_HW_PWM
    bool

config FEATURE_HW_GPIO
    bool

config FEATURE_HW_UART
    bool

config FEATURE_HW_SPI
    bool

config FEATURE_HW_I2C
    bool

config FEATURE_FLOW
    bool

config FEATURE_FILESYSTEM
    bool

config FEATURE_CC_SANITIZE
    bool
```

## tools/build/Kconfig.linux
```kconfig
config LINUX
    def_bool y
    select FEATURE_BLUETOOTH if HAVE_SYSTEMD
    select FEATURE_NETCTL if HAVE_SYSTEMD && HAVE_CONNMAN
    select FEATURE_CC_SANITIZE
    select FEATURE_COAP
    select FEATURE_CRYPTO_MESSAGE_DIGEST
    select FEATURE_DYNAMIC_LINKER
    select FEATURE_EFI
    select FEATURE_FILESYSTEM
    select FEATURE_FLASH_MEM
    select FEATURE_FLOW
    select FEATURE_HTTP_CLIENT if HAVE_LIBCURL
    select FEATURE_HTTP_SERVER if HAVE_LIBMICROHTTPD
    select FEATURE_HW_AIO
    select FEATURE_HW_GPIO
    select FEATURE_HW_I2C
    select FEATURE_HW_PWM
    select FEATURE_HW_SPI
    select FEATURE_HW_UART
    select FEATURE_MQTT if HAVE_MOSQUITTO
    select FEATURE_NETWORK
    select FEATURE_OIC
    select FEATURE_PIN_MUX
    select FEATURE_RUNNABLE_PROGRAMS
    select FEATURE_UNIX_SOCKETS
    select FEATURE_WORKER_THREADS
```

## tools/build/Kconfig.riot
```kconfig
config RIOT
    def_bool y
    select FEATURE_HW_AIO
    select FEATURE_HW_PWM
    select FEATURE_HW_SPI
    select FEATURE_HW_GPIO
    select FEATURE_HW_UART
    select FEATURE_HW_I2C
    select FEATURE_NETWORK
    select FEATURE_COAP
    select FEATURE_FLOW
```

## tools/build/Kconfig.unix
```kconfig
config UNIX
    def_bool y
    select FEATURE_DYNAMIC_LINKER
    select FEATURE_RUNNABLE_PROGRAMS
    select FEATURE_WORKER_THREADS
    select FEATURE_UNIX_SOCKETS
    select FEATURE_CRYPTO_MESSAGE_DIGEST
    select FEATURE_NETWORK
    select FEATURE_COAP
    select FEATURE_HTTP_CLIENT if HAVE_LIBCURL
    select FEATURE_HTTP_SERVER if HAVE_LIBMICROHTTPD
    select FEATURE_FLOW
    select FEATURE_FILESYSTEM
```

## tools/build/Kconfig.zephyr
```kconfig
config FEATURE_ZEPHYR_MICROKERNEL
    bool

config ZEPHYR
    def_bool y
    select FEATURE_COAP
    select FEATURE_FLASH_MEM
    select FEATURE_FLOW
    select FEATURE_HW_AIO
    select FEATURE_HW_GPIO
    select FEATURE_HW_I2C
    select FEATURE_HW_IPM
    select FEATURE_HW_PWM
    select FEATURE_HW_SPI
    select FEATURE_NETWORK
    select FEATURE_OIC
    select FEATURE_ZEPHYR_MICROKERNEL if HAVE_ZEPHYR_MICRO
```
