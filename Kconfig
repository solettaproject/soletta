## src/lib/comms/Kconfig
```kconfig
config NETWORK
	bool "Network"
	default y
	help
            Network library provides a way to handle network link interfaces,
            making it possible to observe events, to inquire available links
            and to set their states.

config DTLS
	bool "Enable DTLS (Datagram Transport Layer Security) support"
	default n
	depends on HAVE_TINYDTLS_SRC
	help
	    This enables support for DTLS (a derivation from the SSL protocol)
	    support in the socket abstraction layer.

	    If unsure, say N.

config DTLS_EXTRAS
	bool "Enable some DTLS extra features used by OIC"
	default n
	depends on DTLS
	help
            This is needed when one wants OIC to support crypto.

config BLUETOOTH
       bool

choice
	prompt "Bluetooth"
	depends on FEATURE_BLUETOOTH && NETWORK
	default BLUETOOTH_BLUEZ if LINUX && HAVE_SYSTEMD
	help
	    Bluetooth is a standardized technology for exchanging data over
	    short distances and building personal area networks.

config BLUETOOTH_BLUEZ
	bool "BlueZ"
	depends on FEATURE_BLUETOOTH && LINUX && HAVE_SYSTEMD
	select BLUETOOTH
	help
            This implementation will use BlueZ via its D-Bus API.

config BLUETOOTH_NONE
       bool "None"
       depends on FEATURE_BLUETOOTH
       select BLUETOOTH
       help
           No implementation is to be used, all functions will return error.

endchoice

config NETCTL
        bool "connection manager interfaces"
        default y
        depends on FEATURE_NETCTL && NETWORK
        help
           This provides the connection manager interfaces API.
           The user can use the connection manager APIs to control
           network and get the network info from connection manager.
           It includes to get the network state, get the name of services
           (wireless AP/Bluetooth Devices/...), get the ip address of
           services, connect/disconnect services and so on.

config COAP
	bool "CoAP"
	default y
	depends on NETWORK && FEATURE_COAP
	help
            The Constrained Application Protocol (CoAP) is a
            specialized web transfer protocol for use with constrained
            nodes and constrained (e.g., low-power, lossy) networks.
            The nodes often have 8-bit microcontrollers with small
            amounts of ROM and RAM, while constrained networks such as
            IPv6 over Low-Power Wireless Personal Area Networks
            (6LoWPANs) often have high packet error rates and a
            typical throughput of 10s of kbit/s.  The protocol is
            designed for machine- to-machine (M2M) applications such
            as smart energy and building automation.

            CoAP provides a request/response interaction model between
            application endpoints, supports built-in discovery of
            services and resources, and includes key concepts of the
            Web such as URIs and Internet media types.  CoAP is
            designed to easily interface with HTTP for integration
            with the Web while meeting specialized requirements such
            as multicast support, very low overhead, and simplicity
            for constrained environments.

            It is used by Open Interconnect Consortium (OIC -
            http://openinterconnect.org/)

            See https://tools.ietf.org/html/rfc7252

config OIC
	bool "OIC"
	default y
	depends on COAP && FEATURE_OIC && HAVE_TINYCBOR_SRC
	help
            Implementation of protocol defined by Open Interconnect Consortium
            (OIC - http://openinterconnect.org/)

            It's a common communication framework based on industry standard
            technologies to wirelessly connect and intelligently manage
            the flow of information among devices, regardless of form factor,
            operating system or service provider.

            Both client and server sides are covered by this library.

menu "OIC Config"
depends on OIC

config OIC_SERVER_COMPAT_1_0
	bool "OIC_SERVER_COMPAT_1_0"
	default false
	help
    Uses payload defined in OIC 1.0 spec. Only select this option if using OIC
    server with clients that doesn't support OIC 1.1 spec.

config OIC_SERVER_MANUFACTURER_NAME
	string "OIC_SERVER_MANUFACTURER_NAME"
	default "Soletta"
	help
    Name of the manufacturer of the device. Used when clients retrieve server
    platform information.

config OIC_SERVER_MANUFACTURER_URL
	string "OIC_SERVER_MANUFACTURER_URL"
	default "https://soletta-project.org"
	help
    URL to manufacturer web site.

config OIC_SERVER_MODEL_NUMBER
	string "OIC_SERVER_MODEL_NUMBER"
	default "Unknown"
	help
    Model number as designated by manufacturer. Used when clients retrieve
    server platform information.

config OIC_SERVER_MANUFACTURE_DATE
	string "OIC_SERVER_MANUFACTURE_DATE"
	default "2015-01-01"
	help
    Date that the device was manufactured. Used when clients retrieve
    server platform information.

config OIC_SERVER_PLATFORM_VERSION
	string "OIC_SERVER_PLATFORM_VERSION"
	default "Unknown"
	help
    Version of the platform as defined by manufacturer. Used when clients
    retrieve server platform information.

config OIC_SERVER_HARDWARE_VERSION
	string "OIC_SERVER_HARDWARE_VERSION"
	default "Unknown"
	help
    Hardware Version as defined by manufacturer. Used when clients retrieve
    server platform information.

config OIC_SERVER_FIRMWARE_VERSION
	string "OIC_SERVER_FIRMWARE_VERSION"
	default "Unknown"
	help
    Firmware version as defined by manufacturer. Used when clients retrieve
    server platform information.

config OIC_SERVER_SUPPORT_URL
	string "OIC_SERVER_SUPPORT_URL"
	default "Unknown"
	help
    URL for manufacturer support. Used when clients retrieve server platform
    information.

config OIC_SERVER_DEVICE_NAME
	string "OIC_SERVER_DEVICE_NAME"
	default "Unknown"
	help
    The name of this device. Used when clients retrieve server device
    information.

endmenu

config HTTP
	bool "HTTP Common"
	default y

config HTTP_CLIENT
	bool "HTTP Client"
	default y
	select HTTP
	depends on NETWORK && FEATURE_HTTP_CLIENT
	help
            Client API for both HTTP and HTTPS.

config HTTP_SERVER
	bool "HTTP Server"
	default y
	select HTTP
	depends on NETWORK && FEATURE_HTTP_SERVER
	help
            Server API for both HTTP and HTTPS.

config HTTP_SERVER_PORT
	depends on HTTP_SERVER
	int "Default server port"
	default "8080" if BUILD_TYPE_DEBUG=y
	default "80"

config MQTT
	bool "MQTT"
	default y
    depends on NETWORK && FEATURE_MQTT
    help
            MQTT is a machine-to-machine (M2M)/"Internet of Things"
            connectivity protocol. It was designed as an extremely
            lightweight publish/subscribe messaging transport. It is useful
            for connections with remote locations where a small code footprint
            is required and/or network bandwidth is at a premium. For example,
            it has been used in sensors communicating to a broker via
            satellite link, over occasional dial-up connections with
            healthcare providers, and in a range of home automation and small
            device scenarios. It is also ideal for mobile applications because
            of its small size, low power usage, minimised data packets, and
            efficient distribution of information to one or many receivers.

            The Soletta implementation of MQTT depends on the mosquitto library
            (http://mosquitto.org/)

config MAVLINK
	bool "Mavlink"
	default y
    depends on LINUX && NETWORK && HAVE_MAVLINK_SRC
    help
            MAVLink or Micro Air Vehicle Link is a protocol for communicating with
            small unmanned vehicle. It is designed as a header-only message marshaling
            library.

config LWM2M
       bool "LWM2M"
       default y
       depends on COAP && HTTP
       help
           LWM2M is a protocol for communication between IoT devices defined by OMA
           (Open Mobile Alliance).
           Both client and server sides are covered by this library.
```

## src/lib/crypto/Kconfig
```kconfig
config CRYPTO_MESSAGE_DIGEST
	bool

choice
	prompt "Message Digest (Hash)"
	depends on FEATURE_CRYPTO_MESSAGE_DIGEST
	default CRYPTO_MESSAGE_DIGEST_LINUX_KCAPI if LINUX
	help
            Message Digest algorithms will take a byte stream and
            compute a hash that may be used to later validate the
            identity. Even the smallest variation of the input data
            will have an avalanche effect that drastically change the
            output data.

            Wikipedia says (https://en.wikipedia.org/wiki/Cryptographic_hash_function):
            The ideal cryptographic hash function has four main properties:
             - it is easy to compute the hash value for any given message
             - it is infeasible to generate a message from its hash
             - it is infeasible to modify a message without changing the hash
             - it is infeasible to find two different messages with the same hash.

            Common Message Digest algorithms are CRC32, MD5, SHA1,
            SHA256 and SHA512. Most of these are already broken, such
            as CRC32 and nowadays MD5 and even SHA1, then before
            picking one for your application, check the one that is
            more secure and hard to break, such as SHA512.


config CRYPTO_MESSAGE_DIGEST_LINUX_KCAPI
	bool "Linux Kernel Crypto API"
	depends on LINUX && FEATURE_CRYPTO_MESSAGE_DIGEST
	select CRYPTO_MESSAGE_DIGEST
	help
            This implementation will use the Kernel-Userspace interface
            provided by Linux. Linux implementation are often very optimized
            and in some case are hardware-accelerated.

config CRYPTO_MESSAGE_DIGEST_NONE
	bool "None"
	depends on FEATURE_CRYPTO_MESSAGE_DIGEST
	select CRYPTO_MESSAGE_DIGEST
	help
            No implementation is to be used, all functions will return error.

endchoice
```

## src/lib/datatypes/Kconfig
```kconfig
menu "Data Type Options"

config MEMDESC_DESCRIPTION
    bool "Include description text in sol_memdesc"
    default n if RIOT || CONTIKI || ZEPHYR
    default y
    help
            Enable description text in sol_memdesc.

            The textual description is used to provide nicer
            introspection when using memory descriptions, however it
            will increase binary size due larger read-only text
            strings, sometimes it's not desired on smaller systems
            where disk footprint matters.

endmenu
```

## src/lib/flow/Kconfig
```kconfig
config USE_FLOW
	bool "Flow support"
	default y

config NODE_DESCRIPTION
	bool "Node description support"
	depends on USE_FLOW && FEATURE_RUNNABLE_PROGRAMS
	default y
	help
            Add node description support to enable runtime introspection.

            If unsure, say Y.

config RESOLVER_CONFFILE
	bool "Resolver conffile"
	depends on NODE_DESCRIPTION && FEATURE_FILESYSTEM
	default y
	help
            For the sol-fbp-runner tool, have the ability to parse
            configuration files declaring node types. This is a way to
            parametrize flows for different platforms/situations and
            still keep a single flow logic. If you know you won't be
            using this feature on the runner tool and want to save
            some space, say N.

            NB.: The sol-fbp-generator tool will always be able to
            resolve from configuration files.

            If unsure, say Y.

config INSPECTOR
	bool "Inspector"
	depends on USE_FLOW && FEATURE_RUNNABLE_PROGRAMS
	default y

menu "Metatypes"
source "src/modules/flow-metatype/js/Kconfig"
source "src/modules/flow-metatype/http-composed-client/Kconfig"
source "src/modules/flow-metatype/http-composed-server/Kconfig"
endmenu

menu "Node Types"
	depends on USE_FLOW
source "src/modules/flow/accelerometer/Kconfig"
source "src/modules/flow/aio/Kconfig"
source "src/modules/flow/am2315/Kconfig"
source "src/modules/flow/app/Kconfig"
source "src/modules/flow/boolean/Kconfig"
source "src/modules/flow/byte/Kconfig"
source "src/modules/flow/calamari/Kconfig"
source "src/modules/flow/color/Kconfig"
source "src/modules/flow/compass/Kconfig"
source "src/modules/flow/console/Kconfig"
source "src/modules/flow/constant/Kconfig"
source "src/modules/flow/converter/Kconfig"
source "src/modules/flow/evdev/Kconfig"
source "src/modules/flow/file/Kconfig"
source "src/modules/flow/filter-repeated/Kconfig"
source "src/modules/flow/float/Kconfig"
source "src/modules/flow/flower-power/Kconfig"
source "src/modules/flow/form/Kconfig"
source "src/modules/flow/format/Kconfig"
source "src/modules/flow/gpio/Kconfig"
source "src/modules/flow/grove/Kconfig"
source "src/modules/flow/gtk/Kconfig"
source "src/modules/flow/gyroscope/Kconfig"
source "src/modules/flow/hc-sr04/Kconfig"
source "src/modules/flow/http-client/Kconfig"
source "src/modules/flow/http-server/Kconfig"
source "src/modules/flow/iio/Kconfig"
source "src/modules/flow/int/Kconfig"
source "src/modules/flow/jhd1313m1/Kconfig"
source "src/modules/flow/ipm/Kconfig"
source "src/modules/flow/json/Kconfig"
source "src/modules/flow/keyboard/Kconfig"
source "src/modules/flow/led-7seg/Kconfig"
source "src/modules/flow/led-strip/Kconfig"
source "src/modules/flow/location/Kconfig"
source "src/modules/flow/lsm9ds0/Kconfig"
source "src/modules/flow/magnetometer/Kconfig"
source "src/modules/flow/max31855/Kconfig"
source "src/modules/flow/mqtt/Kconfig"
source "src/modules/flow/network/Kconfig"
source "src/modules/flow/netctl/Kconfig"
source "src/modules/flow/oauth/Kconfig"
source "src/modules/flow/oic/Kconfig"
source "src/modules/flow/persistence/Kconfig"
source "src/modules/flow/piezo-speaker/Kconfig"
source "src/modules/flow/platform/Kconfig"
source "src/modules/flow/power-supply/Kconfig"
source "src/modules/flow/process/Kconfig"
source "src/modules/flow/pwm/Kconfig"
source "src/modules/flow/random/Kconfig"
source "src/modules/flow/regexp/Kconfig"
source "src/modules/flow/robotics/Kconfig"
source "src/modules/flow/servo-motor/Kconfig"
source "src/modules/flow/si114x/Kconfig"
source "src/modules/flow/string/Kconfig"
source "src/modules/flow/stts751/Kconfig"
source "src/modules/flow/switcher/Kconfig"
source "src/modules/flow/temperature/Kconfig"
source "src/modules/flow/test/Kconfig"
source "src/modules/flow/thingspeak/Kconfig"
source "src/modules/flow/timer/Kconfig"
source "src/modules/flow/timestamp/Kconfig"
source "src/modules/flow/trigonometry/Kconfig"
source "src/modules/flow/twitter/Kconfig"
source "src/modules/flow/udev/Kconfig"
source "src/modules/flow/unix-socket/Kconfig"
source "src/modules/flow/update/Kconfig"
source "src/modules/flow/wallclock/Kconfig"
endmenu
```
